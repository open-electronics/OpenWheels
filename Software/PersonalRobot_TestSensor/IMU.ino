/*
  OpenWheels V2.0
  IMU GY-512 with MPU-6050
  pin AD0 is connect to GND
  IMU is powered with 5V
  I2C BUS work at 3V3 with internal module 4K7 R-pullup
  from: http://playground.arduino.cc/Main/MPU-6050
 */

/*
  analog IMU
  
*/

//select type of IMU
//#define analogIMU
#define digitalIMU

void initIMU()
{
  #ifdef digitalIMU  
    MPU6050_init();  
  #endif  
} 

void readIMU()
{
  byte error;
  
  #ifdef analogIMU
    Acc_RAW = analogRead(Acc_ADC_pin);
    Gyro_RAW = analogRead(Gyro_ADC_pin);  
  #endif  
  #ifdef digitalIMU
    error = MPU6050_read_int (MPU6050_ACCEL_YOUT_H, &Acc_RAW);
    error = MPU6050_read_int (MPU6050_GYRO_YOUT_H, &Gyro_RAW);
  #endif
}

void MPU6050_init()
{  
  byte error;
  byte data;  
  
  Wire.begin();
  // Disable internal Arduino R-pullup
  digitalWrite(SDA, 0);
  digitalWrite(SCL, 0);    
  
  // default at power-up:
  //    Gyro at 250 degrees second
  //    Acceleration at 2g
  //    Clock source at internal 8MHz
  //    The device is in sleep mode.
//  Serial.print("MPU6050 init...");  
    error = MPU6050_read_byte (MPU6050_WHO_AM_I, &data); //se non c'è MPU si blocca qui...
  
	if(data == 0x68)
	{
		Serial.print("I2C Read Test Passed, MPU6050 Address: 0x");
                Serial.println(data,HEX);
	}
	else
	{
		Serial.println("I2C Read Test Failed! NO MPU6050");
		//while(1){}	
	}  

  // Clear the 'sleep' bit to start the sensor.  
  error = MPU6050_write(MPU6050_PWR_MGMT_1, 0);
  
    //setIMU(0x19, ?); // SMPRT_DIV
  /* This register specifies the divider from the gyroscope output rate used to generate the Sample Rate for the MPU-60X0.
     The sensor register output, FIFO output, DMP sampling and Motion detection are all based on the Sample Rate.
     The Sample Rate is generated by dividing the gyroscope output rate by SMPLRT_DIV: Sample Rate = Gyroscope Output Rate / (1 + SMPLRT_DIV)
     where Gyroscope Output Rate = 8kHz when the DLPF is disabled (DLPF_CFG = 0 or 7), and 1kHz when the DLPF is enabled (see Register 26).
     The accelerometer output rate is 1kHz. */
  
    //setIMU(0x1A, ?); // DLPF_CFG set cut off frequency of filter
  
//    setIMU(0x1B, 0); // GYRO_CONFIG Gyro Full Scale Range ± 250 °/s (131 LSB/°/s)
//    setIMU(0x1C, 0); // ACCEL_CONFIG Acc  Full Scale Range ± 2g (16384 LSB/g)
//    setIMU(0x19, 7); // SMPRT_DIV (This register specifies the divider from the gyroscope output rate used to generate the Sample Rate) Giroscope sample rate = 1KHz
//    setIMU(0x6B, 0); // PWR_MGMT_1 (This register allows the user to configure the power mode and clock source) wakes up the MPU-6050, Internal 8MHz oscillator  
}

// --------------------------------------------------------
// MPU6050_read_byte
// This is a common function to read ONE bytes from an I2C device.

byte MPU6050_read_byte(byte regAddr, byte *data)
{
  byte error;
  Wire.beginTransmission(MPU6050_I2C_ADDRESS);
  Wire.write(regAddr);
  error = Wire.endTransmission(false);    // hold the I2C-bus
  if (error != 0)
    return (error);

  // Third parameter is true: relase I2C-bus after data is read.
  Wire.requestFrom(MPU6050_I2C_ADDRESS, 1, true);
  if (Wire.available() != 1)
    return(5);  //data is not modified
    
  data[0]=Wire.read();
  return (0);  // return : no error
}

// --------------------------------------------------------
// MPU6050_read_int
// This is a common function to read TWO bytes from an I2C device.

byte MPU6050_read_int(byte regAddr, int *data)
{
  byte error;

  Wire.beginTransmission(MPU6050_I2C_ADDRESS);
  Wire.write(regAddr);
  error = Wire.endTransmission(false);    // hold the I2C-bus

  // Third parameter is true: relase I2C-bus after data is read.
  Wire.requestFrom(MPU6050_I2C_ADDRESS, 2, true);
  if (Wire.available() != 2)
    return(5);  //data is not modified
  *data=Wire.read()<<8|Wire.read();
   
  return (0);  // return : no error
}


// --------------------------------------------------------
// MPU6050_write
// This is a common function to write ONE bytes to an I2C device.

byte MPU6050_write(byte regAddr, byte data)
{
  byte error;

  Wire.beginTransmission(MPU6050_I2C_ADDRESS);
  Wire.write(regAddr);        // write the register address
  Wire.write(data);  // write one bytes
  error = Wire.endTransmission(true); // release the I2C-bus
  if (error != 0)
    return (error);

  return (0);         // return : no error
}

// --------------------------------------------------------
// MPU6050_read_Accelerometer
// This is a common function to read ACC.
int readAcc()
{
  byte error;
  int data;
  Wire.beginTransmission(MPU6050_I2C_ADDRESS);
  Wire.write(MPU6050_ACCEL_YOUT_H);
  error = Wire.endTransmission(false);    // hold the I2C-bus
  // Third parameter is true: relase I2C-bus after data is read.
  Wire.requestFrom(MPU6050_I2C_ADDRESS, 2, true);
  data=Wire.read()<<8|Wire.read();   
  return (data);
}

// --------------------------------------------------------
// MPU6050_read_Gyroscope
// This is a common function to read GYRO.
int readGyro()
{
  byte error;
  int data;
  Wire.beginTransmission(MPU6050_I2C_ADDRESS);
  Wire.write(MPU6050_GYRO_YOUT_H);
  error = Wire.endTransmission(false);    // hold the I2C-bus
  // Third parameter is true: relase I2C-bus after data is read.
  Wire.requestFrom(MPU6050_I2C_ADDRESS, 2, true);
  data=Wire.read()<<8|Wire.read();   
  return (data);
}
  

